<dec f='linux-5.3.1/include/linux/netfilter/nf_conntrack_pptp.h' l='40' type='struct nf_ct_gre_keymap *[2]'/>
<offset>128</offset>
<doc f='linux-5.3.1/include/linux/netfilter/nf_conntrack_pptp.h' l='38'>/* in pre-2.6.11 this used to be per-expect. Now it is per-conntrack
	 * and therefore imposes a fixed limit on the number of maps */</doc>
